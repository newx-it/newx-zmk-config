## config/west.yml
```yaml
manifest:
  remotes:
    - name: badjeff
      url-base: https://github.com/badjeff
    - name: carrefinho
      url-base: https://github.com/carrefinho
    - name: dhruvinsh
      url-base: https://github.com/dhruvinsh    
    - name: newx-it
      url-base: https://github.com/newx-it
    - name: nguyendown
      url-base: https://github.com/nguyendown 
    - name: quark-works
      url-base: https://github.com/quark-works   
    - name: urob
      url-base: https://github.com/urob
    - name: nrfconnect
      url-base: https://github.com/nrfconnect
    - name: zmk
      url-base: https://github.com/zmkfirmware
    - name: r4zendev
      url-base: https://github.com/r4zendev
  projects:
    - name: zmk
      remote: zmk
      revision: main
      import: app/west.yml
    - name: zmk-auto-layer
      remote: urob
      revision: main # set to same version as zmk above
    - name: zmk-adaptive-key
      remote: r4zendev
      revision: skipmagic
    - name: zmk-unicode
      remote: urob
      revision: main
    - name: zmk-behavior-socd
      remote: nguyendown
      revision: main
    - name: zmk-tri-state
      remote: dhruvinsh
      revision: main
    - name: zmk-behavior-battery-percentage-printer
      remote: badjeff
      revision: main
    - name: prospector-zmk-module
      remote: newx-it
      revision: newx-it-esb
    - name: palindrome-zmk-config
      remote: newx-it
      revision: esb
    - name: zmk-feature-split-esb
      remote: badjeff
      revision: main
    - name: zmk-keyboard-lebroke
      remote: newx-it
      revision: main
    - name: zmk-keyboard-ocarina
      remote: newx-it
      revision: main
    - name: zmk-keyboard-pocketpilot
      remote: newx-it
      revision: main
    - name: zmk-keyboard-pueo
      remote: newx-it
      revision: main
    - name: zmk-keyboard-swagboard
      remote: newx-it
      revision: main
    - name: zmk-keyboard-twenny
      remote: newx-it
      revision: main
    - name: zmk-keyboard-wakizashi
      remote: newx-it
      revision: main
  self:
    path: config
```
